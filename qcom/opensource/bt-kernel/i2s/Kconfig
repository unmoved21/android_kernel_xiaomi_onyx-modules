## qcom/opensource/bt-kernel/i2s/Kconfig
```kconfig
# SPDX-License-Identifier: GPL-2.0-only
config BTFM_I2S
	tristate "MSM Bluetooth/FM I2S Device"
	depends on SND_SOC && MSM_BT_POWER
	help
		This enables Bluetooth audio over the I2S
		interface on platforms that use I2S

		Say Y here to compile support for Bluetooth/FM over I2S
		into the kernel or say M to compile as a module.
```

## qcom/opensource/touch-drivers/gt9xx/Kconfig
```kconfig
#
# Goodix GT9xx Touchscreen driver
#
config TOUCHSCREEN_GT9XX
	bool "Goodix touchpanel GT9xx series"
	depends on I2C
	help
          Say Y here if your device uses a Goodix GT9xx series
          capacitive touchscreen controller connected over I2C.
          This driver enables basic touch functionality and handles
          initialization, coordinate reporting and interrupt processing.

          If unsure, say N.

config TOUCHSCREEN_GT9XX_UPDATE
	tristate "Goodix GT9xx touch controller auto update support"
	depends on TOUCHSCREEN_GT9XX
	default n
	help
          Enable this option to allow firmware update support for
          Goodix GT9xx series touch controllers. The driver will load
          update images and apply them during boot or when triggered,
          ensuring the controller runs the latest firmware.

	  If unsure, say N.

config TOUCHSCREEN_GT9XX_DEBUG
	tristate "Goodix GT9xx Tools for debuging"
	depends on TOUCHSCREEN_GT9XX
	default n
	help
	  This implement interface support for Goodix GT9xx
	  touchscreen debug.

	  Say Y here if you want to have a Android app debug interface
	  to your system.

	  If unsure, say N.
```
